## CMakeLists.txt
```
cmake_minimum_required(VERSION 3.20.0)

find_package(Zephyr REQUIRED HINTS $ENV{ZEPHYR_BASE})
project(g2labs_esp32c6_edge_node)

target_sources(app PRIVATE src/main.c)
```

## prj.conf
```kconfig
CONFIG_MAIN_STACK_SIZE=8192
CONFIG_SYSTEM_WORKQUEUE_STACK_SIZE=8192

CONFIG_LOG=y
CONFIG_LOG_DEFAULT_LEVEL=3

CONFIG_SHELL=y
CONFIG_SHELL_BACKEND_SERIAL=y
CONFIG_SHELL_BACKEND_DUMMY=y
CONFIG_SHELL_STACK_SIZE=8192
CONFIG_SHELL_LOG_BACKEND=y

CONFIG_NETWORKING=y
CONFIG_NET_TCP=y
CONFIG_NET_UDP=y
CONFIG_NET_IPV4=y
CONFIG_NET_IPV6=n
CONFIG_NET_SOCKETS=y
CONFIG_NET_CONNECTION_MANAGER=y
CONFIG_TEST_RANDOM_GENERATOR=y

CONFIG_GPIO=y
CONFIG_GPIO_SHELL=y

CONFIG_NET_DHCPV4=y

CONFIG_NET_MGMT=y
CONFIG_WIFI=y
CONFIG_WIFI_NM=y
CONFIG_NET_L2_WIFI_MGMT=y
CONFIG_WIFI_CREDENTIALS=y
CONFIG_WIFI_CREDENTIALS_BACKEND_SETTINGS=y
CONFIG_WIFI_CREDENTIALS_CONNECT_STORED=y

CONFIG_NET_SHELL=y
CONFIG_NET_L2_WIFI_SHELL=y

CONFIG_SETTINGS=y
CONFIG_SETTINGS_SHELL=y
CONFIG_SETTINGS_NVS=y
CONFIG_SETTINGS_RUNTIME=y
CONFIG_NVS=y

CONFIG_BOOTLOADER_MCUBOOT=y

CONFIG_ZCBOR=y
CONFIG_NET_BUF=y

CONFIG_FLASH=y
CONFIG_FLASH_MAP=y

CONFIG_STREAM_FLASH=y
CONFIG_IMG_MANAGER=y

CONFIG_MCUMGR=y
CONFIG_MCUMGR_GRP_IMG=y
CONFIG_MCUMGR_GRP_OS=y
CONFIG_MCUMGR_TRANSPORT_UDP=y
CONFIG_MCUMGR_TRANSPORT_UDP_IPV4=y

# mDNS
CONFIG_DNS_RESOLVER=y
CONFIG_MDNS_RESOLVER=y
CONFIG_MDNS_RESPONDER=y

# Hostname
CONFIG_NET_HOSTNAME_ENABLE=y
CONFIG_NET_HOSTNAME="esp32c6-edge-node"
CONFIG_ZVFS_POLL_MAX=10
```

## src/main.c
```c
#include <zephyr/app_version.h>
#include <zephyr/autoconf.h>
#include <zephyr/kernel.h>
#include <zephyr/logging/log.h>
#include <zephyr/net/conn_mgr_monitor.h>
#include <zephyr/net/net_event.h>
#include <zephyr/net/net_if.h>
#include <zephyr/net/net_mgmt.h>
#include <zephyr/net/wifi_mgmt.h>

LOG_MODULE_REGISTER(main, LOG_LEVEL_DBG);
#define WIFI_TIMER_TIMEOUT_SECONDS 10

static void wifi_timer_expiry_cb(struct k_timer* timer);

K_SEM_DEFINE(wifi_sem, 0, 1);
K_MUTEX_DEFINE(wifi_mutex);
K_TIMER_DEFINE(wifi_timer, wifi_timer_expiry_cb, NULL);
static bool wifi_connected = false;

static int wifi_connect_stored() {
    struct net_if* iface = net_if_get_wifi_sta();
    if (iface == NULL) {
        LOG_ERR("Failed to get Wi-Fi interface");
        return -1;
    }

    k_timer_start(&wifi_timer, K_SECONDS(WIFI_TIMER_TIMEOUT_SECONDS),
                  K_NO_WAIT);

    int rc = net_mgmt(NET_REQUEST_WIFI_CONNECT_STORED, iface, NULL, 0);
    if (rc) {
        LOG_ERR("Failed to connect to Wi-Fi: %d", rc);
        return -1;
    }
    return 0;
}

static void wifi_timer_expiry_cb(struct k_timer* timer) {
    ARG_UNUSED(timer);
    LOG_ERR("Wi-Fi connection timed out");
    wifi_connect_stored();
}

static void net_mgmt_event_handler(struct net_mgmt_event_callback* cb,
                                   uint64_t mgmt_event,
                                   struct net_if* iface) {
    ARG_UNUSED(cb);
    ARG_UNUSED(iface);

    if (mgmt_event == NET_EVENT_L4_CONNECTED) {
        LOG_INF("Network connected");
        k_timer_stop(&wifi_timer);
        k_mutex_lock(&wifi_mutex, K_FOREVER);
        wifi_connected = true;
        k_mutex_unlock(&wifi_mutex);
        k_sem_give(&wifi_sem);
    } else if (mgmt_event == NET_EVENT_L4_DISCONNECTED) {
        k_timer_stop(&wifi_timer);
        LOG_INF("Network disconnected");
        k_mutex_lock(&wifi_mutex, K_FOREVER);
        wifi_connected = false;
        k_mutex_unlock(&wifi_mutex);
    } else {
        LOG_WRN("Unknown network event: %lld", mgmt_event);
    }
}

static void wait_for_wifi() {
    LOG_INF("Waiting for Wi-Fi connection...");
    k_sem_take(&wifi_sem, K_FOREVER);
    k_mutex_lock(&wifi_mutex, K_FOREVER);
    if (wifi_connected) {
        LOG_INF("Wi-Fi is connected - mutex");
    } else {
        LOG_ERR("Wi-Fi connection failed - mutex");
    }
    k_mutex_unlock(&wifi_mutex);
}

static int wifi_init(void) {
    struct net_if* iface = net_if_get_wifi_sta();
    if (iface == NULL) {
        LOG_ERR("Failed to get Wi-Fi interface");
        return -1;
    }

    static struct net_mgmt_event_callback wifi_cb;
    net_mgmt_init_event_callback(
        &wifi_cb, net_mgmt_event_handler,
        NET_EVENT_L4_CONNECTED | NET_EVENT_L4_DISCONNECTED);
    net_mgmt_add_event_callback(&wifi_cb);
    conn_mgr_mon_resend_status();

    return wifi_connect_stored();
}

int main(void) {
    LOG_INF("Firmware version: " APP_VERSION_EXTENDED_STRING);

    if (wifi_init() != 0) {
        return -1;
    }
    wait_for_wifi();

    while (1) {
        k_sleep(K_SECONDS(10));
    }
}
```
