## firmware/manifest/west.yml
```yaml
manifest:
  version: "0.12"

  remotes:
    - name: zephyrproject
      url-base: https://github.com/zephyrproject-rtos

  projects:
    - name: zephyr
      remote: zephyrproject
      repo-path: zephyr
      revision: HEAD   
      import: true

  self:
    path: .
```
